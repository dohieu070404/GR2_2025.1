## firmware/idf/zigbee_coordinator_esp32c6/main/Kconfig.projbuild
```kconfig
menu "SmartHome Zigbee Coordinator"

config SMARTHOME_UART_PORT
    int "UART port" 
    default 1
    range 0 2
    help
        UART peripheral used for JSON bridge to the Hub Host.

config SMARTHOME_UART_TX_PIN
    int "UART TX GPIO"
    default 16
    help
        TX pin for coordinator -> hub host.

config SMARTHOME_UART_RX_PIN
    int "UART RX GPIO"
    default 17
    help
        RX pin for hub host -> coordinator.

config SMARTHOME_UART_BAUD
    int "UART baudrate"
    default 115200

config SMARTHOME_UART_RX_BUF_SIZE
    int "UART RX buffer size"
    default 2048

endmenu
```

## firmware/idf/zigbee_enddevice_light/main/Kconfig.projbuild
```kconfig
menu "SmartHome Zigbee End Device (Light)"

config SMARTHOME_LIGHT_GPIO
    int "On/Off GPIO"
    default 2
    help
        GPIO output driven by the Zigbee On/Off attribute.

config SMARTHOME_LIGHT_ACTIVE_HIGH
    bool "GPIO active-high"
    default y
    help
        If enabled, GPIO=1 means ON. If disabled, GPIO=0 means ON.

config SMARTHOME_LIGHT_PWM_GPIO
    int "PWM GPIO (optional, 0 to disable)"
    default 0
    help
        Optional PWM output driven by the Zigbee Level Control current level.

config SMARTHOME_LIGHT_PWM_FREQ_HZ
    int "PWM frequency (Hz)"
    default 5000
    range 1 50000

endmenu
```

## firmware/idf/zigbee_enddevice_sensor/main/Kconfig.projbuild
```kconfig
menu "SmartHome Zigbee End Device (Sensor)"

config SMARTHOME_SENSOR_REPORT_INTERVAL_S
    int "Report interval (seconds)"
    default 10
    range 2 3600
    help
        How often to update attribute values and send reports.

endmenu
```
